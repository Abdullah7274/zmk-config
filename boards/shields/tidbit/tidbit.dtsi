/ {
    key_matrix {
        compatible = "zmk,matrix-transform";
        rows = <5>;
        columns = <5>;
        row-gpios = <&gpio0 2 GPIO_ACTIVE_LOW>,
                    <&gpio0 3 GPIO_ACTIVE_LOW>,
                    <&gpio0 4 GPIO_ACTIVE_LOW>,
                    <&gpio0 5 GPIO_ACTIVE_LOW>,
                    <&gpio0 6 GPIO_ACTIVE_LOW>;
                    
        col-gpios = <&gpio0 10 GPIO_ACTIVE_LOW>,
                    <&gpio0 11 GPIO_ACTIVE_LOW>,
                    <&gpio0 12 GPIO_ACTIVE_LOW>,
                    <&gpio0 13 GPIO_ACTIVE_LOW>,
                    <&gpio0 14 GPIO_ACTIVE_LOW>;
        diode-direction = <COL2ROW>;
    };
};
